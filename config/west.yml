## config/west.yml
```yaml
manifest:
  remotes:
    - name: slicemk
      url-base: https://github.com/TomFaulkner
  projects:
    - name: zmk
      remote: slicemk
      revision: main
      import: app/west.yml
  self:
    path: config
```
